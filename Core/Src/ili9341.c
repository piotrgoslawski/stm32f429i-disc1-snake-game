#include "ili9341.h"
#include "log.h"
#include <string.h>

/* SPI5 GPIO: SCK=PF7(AF5), MOSI=PF9(AF5), CS=PC2, DC=PD13 */
#define LCD_CS_PIN   GPIO_PIN_2
#define LCD_CS_PORT  GPIOC
#define LCD_DC_PIN   GPIO_PIN_13
#define LCD_DC_PORT  GPIOD

#define LCD_CS_LOW()   HAL_GPIO_WritePin(LCD_CS_PORT, LCD_CS_PIN, GPIO_PIN_RESET)
#define LCD_CS_HIGH()  HAL_GPIO_WritePin(LCD_CS_PORT, LCD_CS_PIN, GPIO_PIN_SET)
#define LCD_DC_CMD()   HAL_GPIO_WritePin(LCD_DC_PORT, LCD_DC_PIN, GPIO_PIN_RESET)
#define LCD_DC_DATA()  HAL_GPIO_WritePin(LCD_DC_PORT, LCD_DC_PIN, GPIO_PIN_SET)

/* 8x8 bitmap font for printable ASCII (0x20–0x7E).
   Each char is 8 bytes; each byte is one row, LSB = leftmost pixel.
   Based on the classic IBM 8x8 font (public domain). */
static const uint8_t font8x8[95][8] = {
    { 0x00,0x00,0x00,0x00,0x00,0x00,0x00,0x00 }, /* 0x20 ' '  */
    { 0x18,0x3C,0x3C,0x18,0x18,0x00,0x18,0x00 }, /* 0x21 '!'  */
    { 0x66,0x66,0x24,0x00,0x00,0x00,0x00,0x00 }, /* 0x22 '"'  */
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    { 0x6E,0x3B,0x00,0x00,0x00,0x00,0x00,0x00 }, /* 0x7E '~'  */
};

static SPI_HandleTypeDef *_hspi;

static void spi_write_byte(uint8_t data)
{
    HAL_SPI_Transmit(_hspi, &data, 1, HAL_MAX_DELAY);
}

static void write_cmd(uint8_t cmd)
{
    LCD_DC_CMD();
    LCD_CS_LOW();
    spi_write_byte(cmd);
    LCD_CS_HIGH();
}

static void write_data(uint8_t data)
{
    LCD_DC_DATA();
    LCD_CS_LOW();
    spi_write_byte(data);
    LCD_CS_HIGH();
}

static void set_address_window(uint16_t x0, uint16_t y0, uint16_t x1, uint16_t y1)
{
    write_cmd(0x2A); /* Column address set */
    write_data(x0 >> 8); write_data(x0 & 0xFF);
    write_data(x1 >> 8); write_data(x1 & 0xFF);

    write_cmd(0x2B); /* Row address set */
    write_data(y0 >> 8); write_data(y0 & 0xFF);
    write_data(y1 >> 8); write_data(y1 & 0xFF);

    write_cmd(0x2C); /* Memory write */
}

void ILI9341_Init(SPI_HandleTypeDef *hspi)
{
    LOG_DEBUG("ILI9341: init start");

    _hspi = hspi;

    /* CS and DC are GPIO outputs — deselect initially */
    LCD_CS_HIGH();
    LCD_DC_DATA();

    HAL_Delay(10);

    write_cmd(0x01); /* Software reset */
    HAL_Delay(120);

    write_cmd(0xCF); /* Power control B */
    write_data(0x00); write_data(0xC1); write_data(0x30);

    write_cmd(0xED); /* Power on sequence */
    write_data(0x64); write_data(0x03); write_data(0x12); write_data(0x81);

    write_cmd(0xE8); /* Driver timing A */
    write_data(0x85); write_data(0x00); write_data(0x78);

    write_cmd(0xCB); /* Power control A */
    write_data(0x39); write_data(0x2C); write_data(0x00);
    write_data(0x34); write_data(0x02);

    write_cmd(0xF7); /* Pump ratio */
    write_data(0x20);

    write_cmd(0xEA); /* Driver timing B */
    write_data(0x00); write_data(0x00);

    write_cmd(0xC0); /* Power control 1 */
    write_data(0x23);

    write_cmd(0xC1); /* Power control 2 */
    write_data(0x10);

    write_cmd(0xC5); /* VCOM control 1 */
    write_data(0x3E); write_data(0x28);

    write_cmd(0xC7); /* VCOM control 2 */
    write_data(0x86);

    write_cmd(0x36); /* Memory access control — landscape mode */
    write_data(0x28); /* MV | BGR. MV alone swaps row/column addressing to go from
                          the panel's native portrait orientation to landscape, but
                          it doesn't say which of the two possible 90° directions
                          (CW/CCW) that swap lands on -- that's fixed by how this
                          specific panel is wired and had to be corrected by
                          physically rotating the display to match. */

    write_cmd(0x3A); /* Pixel format: 16-bit RGB565 */
    write_data(0x55);

    write_cmd(0xB1); /* Frame rate: ~60 Hz */
    write_data(0x00); write_data(0x18);

    write_cmd(0xB6); /* Display function control */
    write_data(0x08); write_data(0x82); write_data(0x27);

    write_cmd(0xF2); /* 3G disable */
    write_data(0x00);

    write_cmd(0x26); /* Gamma set */
    write_data(0x01);

    write_cmd(0xE0); /* Positive gamma correction */
    write_data(0x0F); write_data(0x31); write_data(0x2B); write_data(0x0C);
    write_data(0x0E); write_data(0x08); write_data(0x4E); write_data(0xF1);
    write_data(0x37); write_data(0x07); write_data(0x10); write_data(0x03);
    write_data(0x0E); write_data(0x09); write_data(0x00);

    write_cmd(0xE1); /* Negative gamma correction */
    write_data(0x00); write_data(0x0E); write_data(0x14); write_data(0x03);
    write_data(0x11); write_data(0x07); write_data(0x31); write_data(0xC1);
    write_data(0x48); write_data(0x08); write_data(0x0F); write_data(0x0C);
    write_data(0x31); write_data(0x36); write_data(0x0F);

    write_cmd(0x11); /* Sleep out */
    HAL_Delay(120);

    write_cmd(0x29); /* Display on */
    HAL_Delay(20);

    LOG_DEBUG("ILI9341: init done");
}

void ILI9341_FillRect(uint16_t x, uint16_t y, uint16_t w, uint16_t h, uint16_t color)
{
    LOG_TRACE("ILI9341: FillRect x=%u y=%u w=%u h=%u color=0x%04X", x, y, w, h, color);

    set_address_window(x, y, x + w - 1, y + h - 1);

    uint8_t hi = color >> 8;
    uint8_t lo = color & 0xFF;

    LCD_DC_DATA();
    LCD_CS_LOW();
    for (uint32_t i = 0; i < (uint32_t)w * h; i++) {
        spi_write_byte(hi);
        spi_write_byte(lo);
    }
    LCD_CS_HIGH();
}

void ILI9341_FillScreen(uint16_t color)
{
    ILI9341_FillRect(0, 0, ILI9341_WIDTH, ILI9341_HEIGHT, color);
}

void ILI9341_DrawChar(uint16_t x, uint16_t y, char c, uint16_t fg, uint16_t bg)
{
    if (c < 0x20 || c > 0x7E)
        c = '?';

    const uint8_t *glyph = font8x8[c - 0x20];

    set_address_window(x, y, x + 7, y + 7);

    uint8_t fg_hi = fg >> 8, fg_lo = fg & 0xFF;
    uint8_t bg_hi = bg >> 8, bg_lo = bg & 0xFF;

    LCD_DC_DATA();
    LCD_CS_LOW();
    for (int row = 0; row < 8; row++) {
        uint8_t bits = glyph[row];
        for (int col = 0; col < 8; col++) {
            if (bits & (1 << col)) {
                spi_write_byte(fg_hi);
                spi_write_byte(fg_lo);
            } else {
                spi_write_byte(bg_hi);
                spi_write_byte(bg_lo);
            }
        }
    }
    LCD_CS_HIGH();
}

void ILI9341_DrawString(uint16_t x, uint16_t y, const char *str, uint16_t fg, uint16_t bg)
{
    LOG_TRACE("ILI9341: DrawString \"%s\" at (%u,%u)", str, x, y);

    while (*str) {
        ILI9341_DrawChar(x, y, *str++, fg, bg);
        x += 8;
        if (x + 8 > ILI9341_WIDTH) {
            x = 0;
            y += 8;
        }
    }
}
